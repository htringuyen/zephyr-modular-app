## blink-driver-module/main/Kconfig
```kconfig
# optionally source global configs for this module
orsource "Kconfig.defconfig"

# load package enabling/disabling configs
rsource "Kconfig.packages"

# optionally load package specific configs
orsource "main/clang/blinkdriver/Kconfig.defconfig"
```

## blink-driver-module/main/Kconfig.packages
```kconfig
menu "Application type"

config TWISTER_TESTING
    bool "Enable twister testing mode"
    default n

endmenu

menu "Package enabling/disabling for blink-driver-module module"

if EXISTS_CUSTOM_CONFIG_BLINK_DRIVER_MODULE_GPIO_LED
source "clang/gpio_led/Kconfig.gpio_led"
endif

if !EXISTS_CUSTOM_CONFIG_BLINK_DRIVER_MODULE_GPIO_LED
config BLINK_DRIVER_MODULE_GPIO_LED
    bool "Enable gpio_led package of blink-driver-module module"
    default n
    help
      Enable the gpio_led package for the blink-driver-module.
endif

endmenu
```

## custom-ek-ra6m3-module/main/Kconfig
```kconfig
# Source kconfig files if exists, otherwise, ignore
orsource "Kconfig.packages"
orsource "package1/Kconfig.package1"
orsource "package2/Kconfig.package2"
# ...
# orsource "packageN/Kconfig.packageN
```

## full-feature-module/main/Kconfig
```kconfig
# load package enabling/disabling configs
rsource "Kconfig.packages"

# optionally load package specific configs
orsource "main/clang/arithmetic/Kconfig.defconfig"
orsource "main/clang/arithmetic/boolean/Kconfig.defconfig"
orsource "main/clang/arithmetic/decimal/Kconfig.defconfig"
orsource "main/clang/bitmath/Kconfig.defconfig"
orsource "main/clang/internal/Kconfig.defconfig"
```

## math-lib-module/main/Kconfig.packages
```kconfig
menu "Application type"

config TWISTER_TESTING
    bool "Enable twister testing mode"
    default n

endmenu

menu "Package enabling/disabling for math-lib-module module"

config MATH_LIB_MODULE_ARITHMETIC
    bool "Enable arithmetic package of math-lib-module module"
    default n

config MATH_LIB_MODULE_ARITHMETIC_BOOLEAN
    bool "Enable arithmetic/module package of math-lib-module module"
    default n

config MATH_LIB_MODULE_ARITHMETIC_DECIMAL
    bool "Enable arithmetic/decimal package of math-lib-module module"
    default n

config MATH_LIB_MODULE_BITMATH
    bool "Enable bitmath package of math-lib-module module"
    default n

config MATH_LIB_MODULE_INTERNAL
    bool "Private package internal, enabled only if its dependents is selected"
    depends on TWISTER_TESTING || MATH_LIB_MODULE_ARITHMETIC_BOOLEAN || MATH_LIB_MODULE_ARITHMETIC_DECIMAL || MATH_LIB_MODULE_BITMATH || MATH_LIB_MODULE_ARITHMETIC
    default y if MATH_LIB_MODULE_ARITHMETIC_BOOLEAN || MATH_LIB_MODULE_ARITHMETIC_DECIMAL || MATH_LIB_MODULE_BITMATH || MATH_LIB_MODULE_ARITHMETIC
    default n if TWISTER_TESTING

endmenu
```

## math-lib-module/test/clang/arithmetic/decimal/testcase.yaml
```yaml
tests:
  math_lib_module.internal: 
    tags:
      - math_lib_module
    platform_allow:
      - unit_testing_ext
```
